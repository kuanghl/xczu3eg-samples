## zcu102-bsp/kernelgen/kernel.its
```
/dts-v1/;

/ {
    description = "U-Boot fitImage for xilinx-zynqmp";
    #address-cells = <1>;

    images {
        kernel@1 {
                description = "Linux kernel";
                data = /incbin/("Image.gz");
                type = "kernel";
                arch = "arm64";
                os = "linux";
                compression = "gzip";
                load = <0x80000>;
                entry = <0x80000>;
                hash@1 {
                    algo = "sha1";
                };
        };
        fdt@1 {
                description = "Flattened Device Tree blob";
                data = /incbin/("system.dtb");
                type = "flat_dt";
                arch = "arm64";
                compression = "none";
                hash@1 {
                    algo = "sha1";
                };
        };
        ramdisk@1 {
                description = "petalinux-user-image";
                data = /incbin/("rootfs.cpio.gz");
                type = "ramdisk";
                arch = "arm64";
                os = "linux";
                compression = "gzip";
                hash@1 {
                    algo = "sha1";
                };
        };
    };


    configurations {
        default = "conf@1";
        conf@1 {
			description = "Linux kernel, FDT blob, ramdisk";
			kernel = "kernel@1";
			fdt = "fdt@1";
			ramdisk = "ramdisk@1";
            hash@1 {
                algo = "sha1";
            };
        };
    };
};
```
