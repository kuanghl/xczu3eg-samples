/*
 * CAUTION: This file is automatically generated by Xilinx.
 * Version: XSCT 2018.3.1
 * Today is: Wed Sep 18 14:38:40 2019
 */


/ {
	amba_pl: amba_pl@0 {
		#address-cells = <2>;
		#size-cells = <2>;
		compatible = "simple-bus";
		ranges ;
		psu_ctrl_ipi: PERIPHERAL@ff380000 {
			/* This is a place holder node for a custom IP, user may need to update the entries */
			compatible = "xlnx,PERIPHERAL-1.0";
			reg = <0x0 0xff380000 0x0 0x80000>;
		};
		psu_message_buffers: PERIPHERAL@ff990000 {
			/* This is a place holder node for a custom IP, user may need to update the entries */
			compatible = "xlnx,PERIPHERAL-1.0";
			reg = <0x0 0xff990000 0x0 0x10000>;
		};
		
		
/********		
		zcu102_system_wrapper_i_zcu102_system_i_MobileNetV1_SSD_inf_dm_0_indata_outdata: dma@a0400000 {
			#dma-cells = <1>;
			clock-names = "s_axi_lite_aclk", "m_axi_mm2s_aclk", "m_axi_s2mm_aclk";
			clocks = <&misc_clk_0>, <&misc_clk_0>, <&misc_clk_0>;
			compatible = "xlnx,axi-dma-7.1", "xlnx,axi-dma-1.00.a";
			interrupt-names = "s2mm_introut";
			interrupt-parent = <&gic>;
			interrupts = <0 90 4>;
			reg = <0x0 0xa0400000 0x0 0x10000>;
			xlnx,addrwidth = <0x20>;
			xlnx,sg-length-width = <0x14>;
			dma-channel@a0400000 {
				compatible = "xlnx,axi-dma-mm2s-channel";
				dma-channels = <0x1>;
				xlnx,datawidth = <0x20>;
				xlnx,device-id = <0x0>;
			};
			dma-channel@a0400030 {
				compatible = "xlnx,axi-dma-s2mm-channel";
				dma-channels = <0x1>;
				interrupts = <0 90 4>;
				xlnx,datawidth = <0x20>;
				xlnx,device-id = <0x0>;
			};
		};
		misc_clk_0: misc_clk_0 {
			#clock-cells = <0>;
			clock-frequency = <200000000>;
			compatible = "fixed-clock";
		};
		zcu102_system_wrapper_i_zcu102_system_i_MobileNetV1_SSD_inf_dm_1_inweight: dma@a0410000 {
			#dma-cells = <1>;
			clock-names = "s_axi_lite_aclk", "m_axi_mm2s_aclk";
			clocks = <&misc_clk_0>, <&misc_clk_0>;
			compatible = "xlnx,axi-dma-7.1", "xlnx,axi-dma-1.00.a";
			reg = <0x0 0xa0410000 0x0 0x10000>;
			xlnx,addrwidth = <0x20>;
			xlnx,sg-length-width = <0x1a>;
			dma-channel@a0410000 {
				compatible = "xlnx,axi-dma-mm2s-channel";
				dma-channels = <0x1>;
				xlnx,datawidth = <0x40>;
				xlnx,device-id = <0x1>;
			};
		};
		zcu102_system_wrapper_i_zcu102_system_i_vdma_1_sensor: dma@a1210000 {
			#dma-cells = <1>;
			clock-names = "s_axi_lite_aclk", "m_axi_s2mm_aclk", "s_axis_s2mm_aclk";
			clocks = <&misc_clk_0>, <&misc_clk_0>, <&misc_clk_0>;
			compatible = "xlnx,axi-vdma-6.3", "xlnx,axi-vdma-1.00.a";
			interrupt-names = "s2mm_introut";
			interrupt-parent = <&gic>;
			interrupts = <0 89 4>;
			reg = <0x0 0xa1210000 0x0 0x10000>;
			xlnx,addrwidth = <0x20>;
			xlnx,flush-fsync = <0x1>;
			xlnx,num-fstores = <0x3>;
			dma-channel@a1210030 {
				compatible = "xlnx,axi-vdma-s2mm-channel";
				interrupts = <0 89 4>;
				xlnx,datawidth = <0x10>;
				xlnx,device-id = <0x0>;
				xlnx,genlock-mode ;
				xlnx,include-dre ;
			};
		};
		zcu102_system_wrapper_i_zcu102_system_i_PL_MAP_s_axi: zcu102_system_wrapper_i_zcu102_system_i_PL_MAP_s_axi@a1200000 {
			reg = <0x0 0xa1200000 0x0 0x10000>;
		};
******************/
	};
};
